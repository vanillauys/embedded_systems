## temp_monitor/sdkconfig.defaults
```kconfig
# Rust often needs a bit of an extra main task stack size compared to C (the default is 3K)
# You might have to increase this further if you allocate large stack variables in the main task
CONFIG_ESP_MAIN_TASK_STACK_SIZE=8192

# Increase a bit these stack sizes as they are also a bit too small by default
CONFIG_ESP_SYSTEM_EVENT_TASK_STACK_SIZE=4096
CONFIG_FREERTOS_IDLE_TASK_STACKSIZE=4096

# You might have to increase this further if you spawn your own Rust threads
# that allocate large stack variables; or better yet - use
# `std::thread::Builder::new().stack_size(XXX)` for spawning
CONFIG_PTHREAD_TASK_STACK_SIZE_DEFAULT=4096

# Step 5 (captive portal) — bumps for HTTP server + our DNS UDP listener.
# HTTP server task stack: default 4096, bumped because our handlers do
# NVS writes + call esp_restart which can push the default over.
CONFIG_HTTPD_STACK_SIZE=8192
# Max request header length — desktop browsers sometimes send long ones.
CONFIG_HTTPD_MAX_REQ_HDR_LEN=1024
CONFIG_HTTPD_MAX_URI_LEN=512
# lwIP sockets: default 10. We use more than default because AP mode runs
# its own HTTP server, DHCP server, DNS server, plus one STA socket later.
CONFIG_LWIP_MAX_SOCKETS=16
```
